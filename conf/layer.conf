## conf/layer.conf
```bitbake
BBPATH .= ":${LAYERDIR}"
BBFILE_COLLECTIONS           += "qti-cv2x"
BBFILE_PRIORITY_qti-cv2x     = "12"
BBFILE_PATTERN_qti-cv2x     := "^${LAYERDIR}/"

LAYERSERIES_COMPAT_qti-cv2x = "dunfell kirkstone"

BBFILES += " ${LAYERDIR}/recipes*/*/*.bb \
             ${LAYERDIR}/recipes*/*/*.bbappend"
```
